## 11-Ethernet-driver/Kconfig
```kconfig
config FAKE_ETHERNET
        tristate "Fake ethernet device for trainning course"
        ---help---
          Say Y if you intend to choose fake ethernet device
```
